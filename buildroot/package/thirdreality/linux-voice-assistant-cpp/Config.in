## buildroot/package/thirdreality/linux-voice-assistant-cpp/Config.in
```kconfig
config BR2_PACKAGE_LINUX_VOICE_ASSISTANT_CPP
	bool "linux-voice-assistant-cpp"
	depends on BR2_INSTALL_LIBSTDCPP
	depends on BR2_TOOLCHAIN_HAS_THREADS
	depends on BR2_TOOLCHAIN_GCC_AT_LEAST_10 # C++20
	select BR2_PACKAGE_JSON_FOR_MODERN_CPP
	select BR2_PACKAGE_LIBCURL
	select BR2_PACKAGE_LIBCURL_FORCE_TLS
	select BR2_PACKAGE_OPENSSL
	select BR2_PACKAGE_LIBCURL_OPENSSL
	select BR2_PACKAGE_LIBCURL_WEBSOCKETS_SUPPORT
	select BR2_PACKAGE_CA_CERTIFICATES
	select BR2_PACKAGE_MPV
	select BR2_PACKAGE_PULSEAUDIO  # default audio output for libmpv
	select BR2_PACKAGE_WEBRTC_AUDIO_PROCESSING  # AGC + NS for the mic
	default n
	help
	  Native Cortana endpoint for ThirdReality TRSPK hardware.
	  Uses HTTPS/WSS for the Cortana control plane and integrates
	  the LED ring, mute GPIO, home button, and audio hardware.

	  Requires a C++20-capable toolchain (gcc >= 10).

	  Retains the historical package and binary names so existing
	  image and service commands remain stable during the fork.
```
